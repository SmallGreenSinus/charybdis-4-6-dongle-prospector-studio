## config/west.yml
```yaml
manifest:
  remotes:
    - name: zmkfirmware
      url-base: https://github.com/zmkfirmware
    - name: badjeff
      url-base: https://github.com/badjeff
    - name: carrefinho
      url-base: https://github.com/carrefinho
    - name: zettaface
      url-base: https://github.com/zettaface

  projects:
    - name: zmk
      remote: zmkfirmware
      revision: v0.3-branch
      import: app/west.yml

    - name: zmk-pmw3610-driver
      remote: badjeff
      revision: zmk-0.3

    - name: prospector-zmk-module
      remote: carrefinho
      revision: main
      
    - name: zmk-input-processor-keybind
      remote: zettaface
      revision: main

  self:
    path: config
```
